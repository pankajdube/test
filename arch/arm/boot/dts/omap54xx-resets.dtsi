/*
 * Device Tree Source for omap54xx reset data
 *
 * Copyright (C) 2014 Texas Instruments, Inc.
 *
 * This program is free software; you can redistribute it and/or modify
 * it under the terms of the GNU General Public License version 2 as
 * published by the Free Software Foundation.
 */
&prm_resets {
	ipu_reset_cpu0: ipu_reset_cpu0 {
			rstctrl_offs = <0x910>;
			ctrl_bit-shift = <0x0>;
			rstst_offs	= <0x914>;
			sts_bit-shift	= <0x0>;
	};
	ipu_reset_cpu1: ipu_reset_cpu1 {
			rstctrl_offs = <0x910>;
			ctrl_bit-shift = <0x1>;
			rstst_offs	= <0x914>;
			sts_bit-shift	= <0x1>;
	};

};
